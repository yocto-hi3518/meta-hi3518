## conf/distro/hidist.conf
```bitbake
GCCVERSION = "6.%"

OLDEST_KERNEL = "2.6.32"
SDK_OLDEST_KERNEL = "2.6.32"

TCMODE ?= "default"
TCLIBC ?= "uclibc"

# Allow single libc distros to disable this code
TCLIBCAPPEND ?= "-${TCLIBC}"
TMPDIR .= "${TCLIBCAPPEND}"

CACHE = "${TMPDIR}/cache/${TCMODE}-${TCLIBC}${@['', '/' + str(d.getVar('MACHINE'))][bool(d.getVar('MACHINE'))]}${@['', '/' + str(d.getVar('SDKMACHINE'))][bool(d.getVar('SDKMACHINE'))]}"

USER_CLASSES ?= ""
PACKAGE_CLASSES ?= "package_ipk"
INHERIT_BLACKLIST = "blacklist"
INHERIT_DISTRO ?= "debian devshell sstate license remove-libtool"
INHERIT += "${PACKAGE_CLASSES} ${USER_CLASSES} ${INHERIT_DISTRO} ${INHERIT_BLACKLIST}"

DISTRO_FEATURES_remove = " 3g bluetooth irda x11 wayland bluez5"
```

## conf/layer.conf
```bitbake
# We have a conf and classes directory, add to BBPATH
BBPATH .= ":${LAYERDIR}"

# We have recipes-* directories, add to BBFILES
BBFILES += "${LAYERDIR}/recipes-*/*/*.bb \
            ${LAYERDIR}/recipes-*/*/*.bbappend"

BBFILE_COLLECTIONS += "meta-hi3518"
BBFILE_PATTERN_meta-hi3518 = "^${LAYERDIR}/"
BBFILE_PRIORITY_meta-hi3518 = "6"

LAYERDEPENDS_meta-hi3518 = "core"
LAYERSERIES_COMPAT_meta-hi3518 = "rocko"
```

## conf/machine/hi3518.conf
```bitbake
#require conf/machine/include/qemu.inc

MACHINE_FEATURES = "alsa usbgadget"
PREFERRED_PROVIDER_virtual/kernel = "linux-yocto"
PREFERRED_VERSION_linux-yocto = "3.0.8"
IMAGE_FSTYPES += "tar.gz"

require conf/machine/include/tune-arm926ejs.inc

KERNEL_IMAGETYPE = "uImage"

SERIAL_CONSOLES = "115200;ttyAMA0"
SERIAL_CONSOLE = "115200;ttyAMA0"

# For runqemu
QB_SYSTEM_NAME = "qemu-system-arm"
QB_MACHINE = "-machine versatilepb"
QB_KERNEL_CMDLINE_APPEND = "console=ttyAMA0,115200 console=tty"
# Add the 'virtio-rng-pci' device otherwise the guest may run out of entropy
#QB_OPT_APPEND = "-show-cursor -usb -device usb-tablet -device virtio-rng-pci"
PREFERRED_VERSION_linux-yocto = "3.0.8"
#QB_DTB = "${@base_version_less_or_equal('PREFERRED_VERSION_linux-yocto', '4.7', '', 'zImage-versatile-pb.dtb', d)}"

SYSVINIT_ENABLED_GETTYS = ""
```
